## Kconfig
```kconfig
config CORNE_XIAO_CHARGE_STATUS
    bool "Corne XIAO split charging status"
    default y if SHIELD_CORNE_XIAO_V2_LEFT || SHIELD_CORNE_XIAO_V2_RIGHT
    depends on ZMK_SPLIT && !ZMK_SPLIT_ROLE_CENTRAL
```

## boards/shields/corne_xiao_dongle/Kconfig.defconfig
```kconfig
# Copyright (c) 2026
# SPDX-License-Identifier: MIT

if SHIELD_CORNE_XIAO_DONGLE || SHIELD_CORNE_XIAO_DONGLE_OLED

config ZMK_KEYBOARD_NAME
    default "CORNE XIAO"

config ZMK_SPLIT_ROLE_CENTRAL
    default y

config ZMK_SPLIT
    default y

config ZMK_SPLIT_BLE_CENTRAL_PERIPHERALS
    default 2

config BT_MAX_CONN
    default 7

config BT_MAX_PAIRED
    default 7

endif

if SHIELD_CORNE_XIAO_DONGLE_OLED

config I2C
    default y

config SSD1306
    default y

endif
```

## boards/shields/corne_xiao_dongle/Kconfig.shield
```kconfig
# Copyright (c) 2026
# SPDX-License-Identifier: MIT

config SHIELD_CORNE_XIAO_DONGLE
    def_bool $(shields_list_contains,corne_xiao_dongle)

config SHIELD_CORNE_XIAO_DONGLE_OLED
    def_bool $(shields_list_contains,corne_xiao_dongle_oled)
```

## boards/shields/corne_xiao_oled_yads/Kconfig.shield
```kconfig
# Copyright (c) 2026
# SPDX-License-Identifier: MIT

config SHIELD_CORNE_XIAO_OLED_YADS
    def_bool $(shields_list_contains,corne_xiao_oled_yads)
```
